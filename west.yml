## west.yml
```yaml
# Copyright (c) 2024 Xili
# SPDX-License-Identifier: Apache-2.0

manifest:
  version: 0.15
  remotes:
    - name: zephyrproject-rtos
      url-base: https://github.com/zephyrproject-rtos

  projects:
    - name: zephyr
      remote: zephyrproject-rtos
      repo-path: zephyr
      revision: v4.4.0
      path: zephyr
      import: true
```
